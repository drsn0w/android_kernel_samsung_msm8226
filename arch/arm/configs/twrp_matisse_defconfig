## arch/arm/configs/twrp_matisse_defconfig
```kconfig
#variant defconfig
CONFIG_MACH_MATISSEWIFI_OPEN=y
CONFIG_SEC_MATISSE_PROJECT=y
CONFIG_SEC_MATISSEWIFI_COMMON=y

#Power Management
CONFIG_FB_MSM_MDSS_TC_DSI2LVDS_WXGA_PANEL=y

#TSP
CONFIG_TOUCHSCREEN_ATMEL_MXT1188S=y
```
